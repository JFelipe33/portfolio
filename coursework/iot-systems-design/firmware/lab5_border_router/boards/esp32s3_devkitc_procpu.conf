## coursework/iot-systems-design/firmware/lab5_border_router/boards/esp32s3_devkitc_procpu.conf
```kconfig
CONFIG_ESP_SPIRAM=y
CONFIG_SPIRAM_MODE_OCT=n
CONFIG_ESP_SPIRAM_SIZE=2097152
CONFIG_ESP_SPIRAM_HEAP_SIZE=524288
CONFIG_ESP_SPIRAM_BSS_RELOC_LIBS_AND_OBJS="libopenthread-ftd.a libopenthread-cli-ftd.a"
```
